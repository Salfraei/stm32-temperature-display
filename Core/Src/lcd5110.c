#include "lcd5110.h"
#include "spi.h"

#include <stdio.h>

#define LCD_DC_PORT    GPIOB
#define LCD_DC_PIN     GPIO_PIN_0

#define LCD_CS_PORT    GPIOB
#define LCD_CS_PIN     GPIO_PIN_1

#define LCD_RST_PORT   GPIOB
#define LCD_RST_PIN    GPIO_PIN_10

#define LCD_WIDTH      84U
#define LCD_BANKS      6U

static const uint8_t font5x7[][5] =
{
    {0x00,0x00,0x00,0x00,0x00},
    {0x00,0x00,0x5F,0x00,0x00},
    {0x00,0x07,0x00,0x07,0x00},
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    {0x08,0x04,0x08,0x10,0x08}
};

static void Nokia5110_WriteCommand(uint8_t command)
{
    HAL_GPIO_WritePin(
        LCD_DC_PORT,
        LCD_DC_PIN,
        GPIO_PIN_RESET
    );

    HAL_GPIO_WritePin(
        LCD_CS_PORT,
        LCD_CS_PIN,
        GPIO_PIN_RESET
    );

    HAL_SPI_Transmit(
        &hspi1,
        &command,
        1U,
        1000U
    );

    HAL_GPIO_WritePin(
        LCD_CS_PORT,
        LCD_CS_PIN,
        GPIO_PIN_SET
    );
}

static void Nokia5110_WriteData(uint8_t data)
{
    HAL_GPIO_WritePin(
        LCD_DC_PORT,
        LCD_DC_PIN,
        GPIO_PIN_SET
    );

    HAL_GPIO_WritePin(
        LCD_CS_PORT,
        LCD_CS_PIN,
        GPIO_PIN_RESET
    );

    HAL_SPI_Transmit(
        &hspi1,
        &data,
        1U,
        1000U
    );

    HAL_GPIO_WritePin(
        LCD_CS_PORT,
        LCD_CS_PIN,
        GPIO_PIN_SET
    );
}

void Nokia5110_Init(void)
{
    HAL_GPIO_WritePin(
        LCD_CS_PORT,
        LCD_CS_PIN,
        GPIO_PIN_SET
    );

    HAL_GPIO_WritePin(
        LCD_RST_PORT,
        LCD_RST_PIN,
        GPIO_PIN_RESET
    );

    HAL_Delay(10U);

    HAL_GPIO_WritePin(
        LCD_RST_PORT,
        LCD_RST_PIN,
        GPIO_PIN_SET
    );

    HAL_Delay(10U);

    Nokia5110_WriteCommand(0x21U);
    Nokia5110_WriteCommand(0xBEU);
    Nokia5110_WriteCommand(0x04U);
    Nokia5110_WriteCommand(0x14U);
    Nokia5110_WriteCommand(0x20U);
    Nokia5110_WriteCommand(0x0CU);

    Nokia5110_Clear();
}

void Nokia5110_Clear(void)
{
    Nokia5110_SetCursor(0U, 0U);

    for (uint16_t index = 0U;
         index < LCD_WIDTH * LCD_BANKS;
         index++)
    {
        Nokia5110_WriteData(0x00U);
    }

    Nokia5110_SetCursor(0U, 0U);
}

void Nokia5110_SetCursor(uint8_t x, uint8_t y)
{
    if (x >= LCD_WIDTH)
    {
        x = 0U;
    }

    if (y >= LCD_BANKS)
    {
        y = 0U;
    }

    Nokia5110_WriteCommand(0x20U);

    Nokia5110_WriteCommand(
        (uint8_t)(0x80U | x)
    );

    Nokia5110_WriteCommand(
        (uint8_t)(0x40U | y)
    );
}

void Nokia5110_WriteChar(char character)
{
    uint8_t font_index;

    if ((character < 32) ||
        (character > 126))
    {
        character = '?';
    }

    font_index =
        (uint8_t)character - 32U;

    Nokia5110_WriteData(0x00U);

    for (uint8_t column = 0U;
         column < 5U;
         column++)
    {
        Nokia5110_WriteData(
            font5x7[font_index][column]
        );
    }

    Nokia5110_WriteData(0x00U);
}

void Nokia5110_WriteString(const char *text)
{
    if (text == NULL)
    {
        return;
    }

    while (*text != '\0')
    {
        Nokia5110_WriteChar(*text);
        text++;
    }
}

void Nokia5110_ShowTemperature(float temperature)
{
    char text[24];

    int whole;
    int decimal;

    /*
     * Перетворюємо float у дві цілі частини,
     * щоб не використовувати %f у snprintf().
     */
    if (temperature >= 0.0f)
    {
        whole = (int)temperature;

        decimal = (int)(
            (temperature - (float)whole) *
            100.0f +
            0.5f
        );
    }
    else
    {
        whole = (int)temperature;

        decimal = (int)(
            ((float)whole - temperature) *
            100.0f +
            0.5f
        );
    }

    if (decimal >= 100)
    {
        if (temperature >= 0.0f)
        {
            whole++;
        }
        else
        {
            whole--;
        }

        decimal = 0;
    }

    snprintf(
        text,
        sizeof(text),
        "%d.%02d C",
        whole,
        decimal
    );

    Nokia5110_Clear();

    Nokia5110_SetCursor(
        6U,
        1U
    );

    Nokia5110_WriteString(
        "Temperature"
    );

    Nokia5110_SetCursor(
        18U,
        3U
    );

    Nokia5110_WriteString(
        text
    );
}